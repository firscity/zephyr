## CMakeLists.txt
```
# SPDX-License-Identifier: Apache-2.0

cmake_minimum_required(VERSION 3.20.0)

find_package(Zephyr REQUIRED HINTS $ENV{ZEPHYR_BASE})
project(xen_fdt_test)

set(ZEPHYR_MODULES ../zephyr-xenlib)
include_directories(app PRIVATE ${CMAKE_CURRENT_SOURCE_DIR}/../zephyr-xenlib/libfdt)
target_sources(app PRIVATE src/main.c)
```

## sample.yaml
```
sample:
  description: A simple application that saves Xen domain FDT
    passed to Zephyr
  name: Save Xen FDT example
```

## prj.conf
```kconfig
CONFIG_MAIN_STACK_SIZE=16384
CONFIG_ISR_STACK_SIZE=16384
CONFIG_TEST_EXTRA_STACK_SIZE=16384

CONFIG_HEAP_MEM_POOL_SIZE=2097152
CONFIG_XEN_LIBFDT=y
CONFIG_SAVE_XEN_FDT=y
```

## src/main.c
```c
/*
 * SPDX-License-Identifier: Apache-2.0
 */

#include <zephyr/kernel.h>
#include <zephyr/sys/byteorder.h>
#include <zephyr/sys/printk.h>

#include <libfdt.h>

extern uint8_t xen_fdt[];

int main(void)
{
	int chosen_offset, lenp;
	const void *fdt = xen_fdt;
	const struct fdt_property *bootargs;

	printk("Saved Xen device tree magic is 0x%x\n",
	       sys_be32_to_cpu(*((uint32_t *) xen_fdt)));

	chosen_offset = fdt_path_offset(fdt, "/chosen");
	if (chosen_offset < 0) {
		printk("No chosen available\n");
		return chosen_offset;
	}

	bootargs = fdt_get_property(fdt, chosen_offset, "bootargs", &lenp);
	if (!bootargs) {
		printk("No bootargs available!\n");
		return -1;
	}

	printk("Zephyr bootargs, received from Xen - \"%s\" \n", bootargs->data);

	return 0;
}
```
