## boards/arm64/xenvm/xenvm_defconfig
```kconfig
CONFIG_SOC_XENVM=y
CONFIG_BOARD_XENVM=y
CONFIG_XEN_INITIAL_DOMAIN=y

# Enable UART driver
CONFIG_SERIAL=y

CONFIG_XIP=n
CONFIG_FLASH_BASE_ADDRESS=0x0
CONFIG_FLASH_SIZE=0
CONFIG_AARCH64_IMAGE_HEADER=y
CONFIG_MAX_XLAT_TABLES=10
CONFIG_HEAP_MEM_POOL_SIZE=1048576

# Enable console
CONFIG_CONSOLE=y
CONFIG_UART_CONSOLE=y

# Enable PV hypervisor console
CONFIG_UART_CONSOLEIO_XEN_HVC=y

# Enable logging subsys
CONFIG_LOG=y
CONFIG_LOG_MODE_MINIMAL=y

CONFIG_TEST=y
#CONFIG_PRINTK_SYNC=y

CONFIG_SHELL=y
CONFIG_SHELL_BACKEND_SERIAL=y
```

## drivers/serial/Kconfig.xen
```kconfig
# Xen hypervisor console via UART setup
#
# Copyright (c) 2021 EPAM Systems
# SPDX-License-Identifier: Apache-2.0
#

config UART_XEN_HVC
	bool "Xen hypervisor console UART Driver"
	select SERIAL_HAS_DRIVER
	select SERIAL_SUPPORT_INTERRUPT
	depends on BOARD_XENVM
	default y
	help
	  Enable Xen hypervisor console driver.

config XEN_HVC_INIT_PRIORITY
	int "Xen hypervisor console init priority"
	default 55
	help
		Set init priority for Xen HVC, should be inited before UART
		console driver and after Xen Enlighten/events initialization
		(for interrupt driven UART)
```
